## Kconfig
```kconfig
menu "Audio Config"

# ------------------------------------------------------------------------------
# Audio Framework (AUDIO_FWK)
# ------------------------------------------------------------------------------
config AUDIO_FWK_MENU
    bool "Enable Audio Framework"
    select AUDIO_FWK if WHC_HOST || WHC_NONE

if AUDIO_FWK_MENU
    choice
        prompt "Select Audio Interfaces"
        config AUDIO_MIXER_MENU
            bool "Mixer"
            select AUDIO_MIXER if WHC_HOST || WHC_NONE
        config AUDIO_PASSTHROUGH_MENU
            bool "PassThrough"
            select AUDIO_PASSTHROUGH if WHC_HOST || WHC_NONE
    endchoice

    if SUPPORT_AUDIO_DEVICE
        menu "Audio Devices"
            comment "Audio Devices"
            config AUDIO_DEVICE_A2DP_MENU
                bool "Bluetooth A2DP Device"
                select AUDIO_DEVICE_A2DP if WHC_HOST || WHC_NONE

            config AUDIO_DEVICE_USB_MENU
                bool "USB Device"
                select AUDIO_DEVICE_USB if WHC_HOST || WHC_NONE
        endmenu
    endif
endif

# ------------------------------------------------------------------------------
# Media Player
# ------------------------------------------------------------------------------
config MEDIA_PLAYER_MENU
    bool "Enable Media Player"
    select AUDIO_FWK_MENU
    select MEDIA_PLAYER if WHC_HOST || WHC_NONE

if MEDIA_PLAYER_MENU
    menu "Media Formats"
        comment "Select supported media formats"

        config MEDIA_FORMAT_WAV_MENU
            bool "WAV"
            select MEDIA_DEMUX_WAV if WHC_HOST || WHC_NONE
            select MEDIA_CODEC_PCM if WHC_HOST || WHC_NONE

        config MEDIA_FORMAT_MP3_MENU
            bool "MP3"
            select MEDIA_DEMUX_MP3 if WHC_HOST || WHC_NONE
            select MEDIA_CODEC_MP3 if WHC_HOST || WHC_NONE

        config MEDIA_FORMAT_AAC_MENU
            bool "AAC"
            select MEDIA_DEMUX_AAC if WHC_HOST || WHC_NONE
            select MEDIA_CODEC_HAAC if WHC_HOST || WHC_NONE
            select THIRD_PARTY_HAAC_MENU

        config MEDIA_FORMAT_M4A_MENU
            bool "M4A"
            select MEDIA_DEMUX_MP4 if WHC_HOST || WHC_NONE
            select MEDIA_CODEC_HAAC if WHC_HOST || WHC_NONE
            select THIRD_PARTY_HAAC_MENU

        config MEDIA_FORMAT_FLAC_MENU
            bool "FLAC"
            select MEDIA_DEMUX_FLAC if WHC_HOST || WHC_NONE
            select THIRD_PARTY_FLAC_MENU

        config MEDIA_FORMAT_AMR_MENU
            bool "AMR"
            select MEDIA_DEMUX_AMR if WHC_HOST || WHC_NONE
            select MEDIA_CODEC_AMR if WHC_HOST || WHC_NONE

        config MEDIA_FORMAT_OGG_MENU
            bool "OGG"
            select MEDIA_DEMUX_OGG if WHC_HOST || WHC_NONE
            if MEDIA_FORMAT_OGG_MENU
                menu "OGG Codec"
                    config MEDIA_OGG_VORBIS_MENU
                        bool "Vorbis"
                        select MEDIA_CODEC_VORBIS if WHC_HOST || WHC_NONE
                        select THIRD_PARTY_TREMOLO_MENU

                    config MEDIA_OGG_OPUS_MENU
                        bool "Opus"
                        select MEDIA_CODEC_OPUS if WHC_HOST || WHC_NONE
                        select THIRD_PARTY_OPUS_MENU
                endmenu
            endif
    endmenu
endif

# ------------------------------------------------------------------------------
# Third Party Libraries
# ------------------------------------------------------------------------------
rsource "third_party/Kconfig"

# ------------------------------------------------------------------------------
# Audio Commands
# ------------------------------------------------------------------------------
rsource "cmds/Kconfig"

endmenu

# ------------------------------------------------------------------------------
# Hidden config symbols (used by CMakeLists.txt)
# ------------------------------------------------------------------------------
config AUDIO_FWK
    bool

config AUDIO_MIXER
    bool

config AUDIO_PASSTHROUGH
    bool

config AUDIO_DEVICE_A2DP
    bool

config AUDIO_DEVICE_USB
    bool

config MEDIA_PLAYER
    bool

config MEDIA_DEMUX_WAV
    bool

config MEDIA_DEMUX_MP3
    bool

config MEDIA_DEMUX_AAC
    bool

config MEDIA_DEMUX_MP4
    bool

config MEDIA_DEMUX_FLAC
    bool

config MEDIA_DEMUX_OGG
    bool

config MEDIA_DEMUX_AMR
    bool

config MEDIA_CODEC_PCM
    bool

config MEDIA_CODEC_MP3
    bool

config MEDIA_CODEC_HAAC
    bool

config MEDIA_CODEC_VORBIS
    bool

config MEDIA_CODEC_OPUS
    bool

config MEDIA_CODEC_AMR
    bool

config MEDIA_CODEC_G711
    bool

config MEDIA_CODEC_GSM
    bool
```

## third_party/Kconfig
```kconfig
menu "Third Party Libraries"

config THIRD_PARTY_HAAC_MENU
    bool "HAAC"
    select THIRD_PARTY_HAAC if WHC_HOST || WHC_NONE
    help
        FDK-AAC library for AAC decoding

config THIRD_PARTY_FLAC_MENU
    bool "FLAC"
    select THIRD_PARTY_FLAC if WHC_HOST || WHC_NONE
    help
        FLAC library for FLAC decoding

config THIRD_PARTY_OPUS_MENU
    bool "libopus"
    select THIRD_PARTY_OPUS if WHC_HOST || WHC_NONE
    help
        Opus library for OPUS decoding

config THIRD_PARTY_TREMOLO_MENU
    bool "Tremolo"
    select THIRD_PARTY_TREMOLO if WHC_HOST || WHC_NONE
    help
        Vorbis library for Vorbis decoding

config THIRD_PARTY_GSM_MENU
    bool "libgsm"
    select THIRD_PARTY_GSM if WHC_HOST || WHC_NONE
    help
        GSM library for AMR decoding

config THIRD_PARTY_SPEEXDSP_MENU
    bool "speexdsp"
    select THIRD_PARTY_SPEEXDSP if WHC_HOST || WHC_NONE
    help
        Speex DSP library

endmenu

# -------------------------------------------------------------
# Hidden config symbols (used by CMakeLists.txt)
# -------------------------------------------------------------

config THIRD_PARTY_HAAC
    bool

config THIRD_PARTY_FLAC
    bool

config THIRD_PARTY_OPUS
    bool

config THIRD_PARTY_TREMOLO
    bool

config THIRD_PARTY_GSM
    bool

config THIRD_PARTY_SPEEXDSP
    bool
```
